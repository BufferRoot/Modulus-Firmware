## firmware/s3-bridge/main/Kconfig.projbuild
```kconfig
menu "Modulus S3 bridge board"

    choice S3_BRIDGE_BOARD
        prompt "Cabinet bridge hardware"
        default S3_BRIDGE_BOARD_MINI1
        help
            Pin map when NVS has no saved `board` key. USB shell `board` lists
            all profiles; `board <id>` remaps UART/LED/HALT on ESP32-S3.

        config S3_BRIDGE_BOARD_MINI1
            bool "ESP32-S3-MINI-1 (handwheel / I2C_ESP32_Module)"

        config S3_BRIDGE_BOARD_XIAO
            bool "Seeed XIAO ESP32-S3 (USB-C)"
            help
                UART1 on D6/D7 (GPIO43/44). HALT on D0 (GPIO1). User LED GPIO21
                active-low. Shell on USB Serial/JTAG. Do not drive GPIO33-37
                (octal PSRAM on ESP32-S3R8).

    endchoice

endmenu
```

## firmware/tab5-c6/components/modulus_zig_c6/Kconfig
```kconfig
menu "Modulus Zig C6"

config MODULUS_ZIG_C6_RUNTIME
    bool "Link Modulus Zig C6 runtime (modulus_zig_c6)"
    default n
    help
        Opt-in: app_main starts Zig via modulus_c6_runtime_start().
        Product image stays C (espnow_handler + hosted). Enable only for experiments.

config MODULUS_C6_BLE
    bool "NimBLE controller on C6 (MODULUS_TAB5 GAP name)"
    default y
    help
        Local NimBLE host after esp_hosted init. esp_hosted 2.11 RPC is Wi-Fi-only;
        P4 BLE HCI/RPC is a later milestone. Disable to save flash/RAM.

config MODULUS_C6_ESPNOW
    bool "ESP-NOW peer links on C6 (alongside esp_hosted Wi-Fi)"
    default n
    help
        Autonomous esp_now on C6 after esp_wifi_start. Default off: SDIO
        espnow_handler owns callbacks. Enable only for experiments.

config MODULUS_C6_ESPNOW_SEND_TEST
    bool "Send ESP-NOW test broadcast (MODULUS) on init"
    default y
    depends on MODULUS_C6_ESPNOW

config MODULUS_C6_THREAD
    bool "OpenThread 802.15.4 on C6 (detached milestone)"
    default n
    depends on !MODULUS_C6_ZIGBEE_EXCLUSIVE
    select OPENTHREAD_ENABLED
    help
        Off by default: ESP-NOW-first Modulus image keeps C6 free of 802.15.4.
        Enable only for a dedicated Thread build (coex with Wi-Fi/BLE).
        Mutually exclusive with CONFIG_MODULUS_C6_ZIGBEE_EXCLUSIVE (one 802.15.4 radio).

config MODULUS_C6_ZIGBEE
    bool "Zigbee 802.15.4 policy on C6 (defer or exclusive stack)"
    default n
    help
        Default product: Zigbee on NanoH2, not C6.
        Enable CONFIG_MODULUS_C6_ZIGBEE_EXCLUSIVE + esp-zigbee-lib for ZBOSS init.

config MODULUS_C6_ZIGBEE_EXCLUSIVE
    bool "Zigbee exclusive (disables Thread; links esp-zigbee-lib)"
    default n
    depends on MODULUS_C6_ZIGBEE
    help
        One 802.15.4 radio cannot run OpenThread and ZBOSS together.
        Build with sdkconfig.defaults.zigbee and idf_component.zigbee.yml.
        Milestone: esp_zb_init log, factory-new, no network steering.

endmenu
```

## firmware/tab5/main/Kconfig.projbuild
```kconfig
menu "Modulus Tab5"

    config MODULUS_WIFI_ENABLED
        bool "Enable C6 hosted wireless (esp_hosted SDIO)"
        default y
        help
            When enabled, wireless_shim powers C6 via PI4IOE and brings up
            esp_wifi_remote over esp_hosted. Disable for P4-only bring-up.

    config MODULUS_C6_BOOT_DELAY_MS
        int "Delay (ms) after WLAN_PWR_EN before esp_hosted connect"
        depends on MODULUS_WIFI_ENABLED
        default 7000
        range 500 10000
        help
            Tab5 cold-boot: measure from first WLAN_PWR_EN (PI4IOE2 init in
            display_shim), WLAN_PWR cycle in wireless_shim, or last GPIO15
            reset (esp_hosted retry). C6 network_adapter needs ~3-5 s after
            power; esp_hosted GPIO15 reset inside esp_wifi_init reboots C6 —
            CONFIG_ESP_HOSTED_SDIO_RESET_DELAY_MS must match this margin.
            Use 7000 ms on Tab5 (5500 ms esp_hosted delay + margin).
            Increase if sdmmc_card_init returns 0x107.
            Do NOT WLAN_PWR-cycle on ESP_RST_USB (serial monitor) — only ensure.

    config MODULUS_C6_THREAD_SUPPORTED
        bool "C6 OpenThread radio available (802.15.4 on SDIO ch10)"
        default n
        depends on MODULUS_WIFI_ENABLED
        help
            Default Modulus C6 image ships with Thread disabled. Enable only
            after flashing a C6 build with CONFIG_MODULUS_C6_THREAD=y.

    config MODULUS_ZIG_UI_ENGINE
        bool "Zig UI engine owns scanout (omit LVGL widget UI)"
        default y
        help
            When enabled, Core-0 zig_ui task drives MIPI via Zig Engine and
            the LVGL widget tree (ui_dashboard / ui_settings*) is not compiled.
            BSP still starts a thin LVGL port for panel bind. Set n for the
            legacy LVGL UI lab build.

endmenu
```
